## esp-dev-kits/examples/esp32-p4-eye/examples/c6_gateway/sdkconfig.defaults
```kconfig
# Bluetooth / NimBLE (BLE client)
CONFIG_BT_ENABLED=y
CONFIG_BT_NIMBLE_ENABLED=y
CONFIG_BT_NIMBLE_ROLE_CENTRAL=y
CONFIG_BT_NIMBLE_ROLE_PERIPHERAL=y
CONFIG_BT_NIMBLE_ROLE_OBSERVER=y
CONFIG_BT_NIMBLE_ROLE_BROADCASTER=y
CONFIG_BT_NIMBLE_MAX_CONNECTIONS=3
CONFIG_BT_NIMBLE_NVS_PERSIST=y

# Partition table plus grande (1.5 MB app au lieu de 1 MB)
CONFIG_PARTITION_TABLE_SINGLE_APP_LARGE=y
```

## esp-dev-kits/examples/esp32-p4-eye/examples/c6_programmer/sdkconfig.defaults
```kconfig
# Console sur USB-Serial-JTAG (UART0 par défaut pour C6)
CONFIG_ESP_CONSOLE_UART_DEFAULT=y
CONFIG_ESP_CONSOLE_UART_NUM=0

# Désactiver les logs bootloader pour ne pas polluer
CONFIG_BOOTLOADER_LOG_LEVEL_NONE=y
CONFIG_LOG_DEFAULT_LEVEL_NONE=y
```

## esp-dev-kits/examples/esp32-p4-eye/examples/c6_uart_bridge/sdkconfig.defaults
```kconfig
# Console sur UART0 (libere USB-Serial-JTAG pour le bridge)
CONFIG_ESP_CONSOLE_UART_DEFAULT=y
# IMPORTANT: desactiver le secondary console qui ecrit aussi sur USB-JTAG
CONFIG_ESP_CONSOLE_SECONDARY_NONE=y
# Reduire les logs bootloader
CONFIG_BOOTLOADER_LOG_LEVEL_WARN=y
```
